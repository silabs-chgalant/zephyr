## CMakeLists.txt
```
# SPDX-License-Identifier: Apache-2.0

cmake_minimum_required(VERSION 3.20.0)

find_package(Zephyr REQUIRED HINTS $ENV{ZEPHYR_BASE})
project(silabs_acmp)

FILE(GLOB app_sources src/*.c)
target_sources(app PRIVATE ${app_sources})
```

## sample.yaml
```
sample:
  description: Silabs ACMP Comparator driver sample
  name: SiLabs ACMP Comparator sample
common:
  platform_allow:
    - xg29_rb4413a
  integration_platforms:
    - xg29_rb4413a
  tags:
    - drivers
    - comparator
```

## prj.conf
```kconfig
CONFIG_GPIO=y
CONFIG_COMPARATOR=y

CONFIG_UART_CONSOLE=n
CONFIG_RTT_CONSOLE=y
CONFIG_USE_SEGGER_RTT=y

CONFIG_DEBUG=y
```

## boards/xg24_dk2601b.overlay
```dts
/*
 * Copyright (c) 2024 Silicon Labs
 *
 * SPDX-License-Identifier: Apache-2.0
 */

#include <zephyr/dt-bindings/comparator/silabs/silabs-acmp.h>
#include <zephyr/dt-bindings/pinctrl/silabs/xg24-pinctrl.h>

&pinctrl {
	acmp0_default: acmp0_default {
		group0{
			silabs,analog-bus = <ABUS_CDODD0_ACMP0>;
		};
	};
};

&acmp0 {
	pinctrl-0 = <&acmp0_default>;
	pinctrl-names = "default";
	status = "okay";

	bias = <0>;
	hysteresis-mode = "disabled";
	accuracy-mode = "low";
	input-range = "full";
	input-positive = <ACMP_INPUT_PC3>;
	input-negative = <ACMP_INPUT_VREFDIV1V25>;
	vref-divider = <63>;
};
```

## boards/xg29_rb4412a.overlay
```dts
/*
 * Copyright (c) 2024 Silicon Labs
 *
 * SPDX-License-Identifier: Apache-2.0
 */

#include <zephyr/dt-bindings/comparator/silabs/silabs-acmp.h>
#include <zephyr/dt-bindings/pinctrl/silabs/xg29-pinctrl.h>

&pinctrl {
	acmp0_default: acmp0_default {
		group0{
			silabs,analog-bus = <ABUS_CDODD0_ACMP0>;
		};
	};
};

&acmp0 {
	pinctrl-0 = <&acmp0_default>;
	pinctrl-names = "default";
	status = "okay";

	bias = <0>;
	hysteresis-mode = "disabled";
	accuracy-mode = "low";
	input-range = "full";
	input-positive = <ACMP_INPUT_PC3>;
	input-negative = <ACMP_INPUT_VREFDIV1V25>;
	vref-divider = <63>;
};
```

## boards/xg29_rb4413a.overlay
```dts
/*
 * Copyright (c) 2024 Silicon Labs
 *
 * SPDX-License-Identifier: Apache-2.0
 */

#include <zephyr/dt-bindings/comparator/silabs-acmp.h>
#include <zephyr/dt-bindings/pinctrl/silabs/xg29-pinctrl.h>

&acmp0 {
	status = "okay";

	bias = <0>;
	hysteresis-mode = "neg10mv";
	accuracy-mode = "high";
	input-range = "full";
	input-positive = <ACMP_INPUT_VSENSE01DIV4>;
	input-negative = <ACMP_INPUT_VREFDIV1V25>;
	vref-divider = <17>;
};
```

## src/main.c
```c
/*
 * Copyright (c) 2024 Silicon Labs
 *
 * SPDX-License-Identifier: Apache-2.0
 */

#include <zephyr/device.h>
#include <zephyr/drivers/comparator.h>
#include <zephyr/drivers/gpio.h>
#include <zephyr/kernel.h>
#include <stdio.h>

static const struct device *const acmp = DEVICE_DT_GET(DT_NODELABEL(acmp0));
static const struct device *const gpioc = DEVICE_DT_GET(DT_NODELABEL(gpioc));

static void acmp_callback(const struct device* dev, void* data) {
	(void)data;
	printf("acmp_callback:\t ACMP FALLING EDGE DETECTED\n");
	return;
}

int main(void)
{
	comparator_set_trigger_callback(acmp, acmp_callback, NULL);
	comparator_set_trigger(acmp, COMPARATOR_TRIGGER_FALLING_EDGE);
	while(1) {
		printf("ACMP Output:\t%d \n", comparator_get_output(acmp));
		k_msleep(200);
	}

	return 0;
}
```
