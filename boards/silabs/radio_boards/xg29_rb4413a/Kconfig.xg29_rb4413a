## boards/silabs/radio_boards/xg29_rb4413a/Kconfig.xg29_rb4413a
```kconfig
# Copyright (c) 2025 Silicon Laboratories Inc.
# SPDX-License-Identifier: Apache-2.0

config BOARD_XG29_RB4413A
	select SOC_PART_NUMBER_EFR32MG29B230F1024CM40
```
